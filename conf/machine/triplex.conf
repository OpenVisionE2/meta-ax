## conf/machine/triplex.conf
```bitbake
#@TYPE: Machine
#@NAME: AX Triplex
#@DESCRIPTION: Machine configuration for the AX Triplex

PREFERRED_VERSION_linux-ax = "4.10.6"

SOC_FAMILY = "bcm7356"

UBI_VOLNAME = "rootfs"
MKUBIFS_ARGS = "-m 2048 -e 126976 -c 8192"
UBINIZE_ARGS = "-m 2048 -p 128KiB"

require conf/machine/include/ax.inc

MACHINE_FEATURES += "dvb-c ci textlcd fan blindscan-tbs"

# Broken bootloader can only flash around 100 MB
FLASHSIZE = "96"

DVBMEDIASINK_CONFIG = "--with-wma --with-wmv --with-pcm --with-dts --with-eac3"
```

## conf/machine/ultrabox.conf
```bitbake
#@TYPE: Machine
#@NAME: AX Ultrabox
#@DESCRIPTION: Machine configuration for the AX Ultrabox

PREFERRED_VERSION_linux-ax = "4.7.6"

SOC_FAMILY = "bcm73625"

UBI_VOLNAME = "rootfs"
MKUBIFS_ARGS = "-m 2048 -e 126976 -c 8192"
UBINIZE_ARGS = "-m 2048 -p 128KiB"

require conf/machine/include/ax.inc

MACHINE_FEATURES += "skins1080"

DVBMEDIASINK_CONFIG = "--with-wma --with-wmv --with-pcm --with-dts --with-eac3 --with-h265 --with-vb6 --with-vb8 --with-spark"
```
